## dts/bindings/power/renesas,ra-battery-backup.yaml
```yaml
description: Renesas RA battery backup domain

compatible: "renesas,ra-battery-backup"

include: base.yaml

properties:
  reg:
    required: true

  reg-names:
    required: true

  switch-threshold:
    type: int
    enum: [0, 1, 2, 3, 4, 5, 6]
    description: |
      VBATT detection threshold (VDETLVL):
        0 = 2.80V
        1 = 2.53V
        2 = 2.10V
        3 = 1.95V
        4 = 1.85V
        5 = 1.75V
        6 = Not used

  manual-configure:
    type: boolean
    description: |
      Battery backup need to configure to use.
      For those do not have this property, hardware
      is automatically switch.
```

## soc/renesas/ra/Kconfig
```kconfig
# Copyright (c) 2023 TOKITA Hiroshi <tokita.hiroshi@fujitsu.com>
# SPDX-License-Identifier: Apache-2.0

config SOC_FAMILY_RENESAS_RA
	select HAS_SEGGER_RTT if ZEPHYR_SEGGER_MODULE

if SOC_FAMILY_RENESAS_RA

config SERIES_SPECIFIC_SOC_INIT
	bool "Use series specific initialize"

rsource "*/Kconfig"

config HAS_RENESAS_RA_BATTERY_BACKUP_DOMAIN
	bool "SoC has a battery backup domain"
	default y
	depends on DT_HAS_RENESAS_RA_BATTERY_BACKUP_ENABLED
	help
		SoC has a battery backup domain

config RENESAS_RA_BATTERY_BACKUP_MANUAL_CONFIGURE
	bool "VBAT switching manual"
	default y
	depends on HAS_RENESAS_RA_BATTERY_BACKUP_DOMAIN && $(dt_compat_any_has_prop,$(DT_COMPAT_RENESAS_RA_BATTERY_BACKUP),manual-configure)
	help
		Enable if this SoC's battery backup domain allows switching to VBAT manually.
		Leave disabled if switching is automatic.

endif # SOC_FAMILY_RENESAS_RA
```
